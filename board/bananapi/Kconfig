## board/bananapi/Kconfig
```kconfig
config BANANAPI_COMMON
        bool
        default y

config BANANAPI_M2S
	bool "Support Bananapi M2S board"
	default n

config BANANAPI_CM4
	bool "Support Bananapi CM4 board"
	default n

if BANANAPI_M2S
source "board/bananapi/bananapi_m2s/Kconfig"
endif

if BANANAPI_CM4
source "board/bananapi/bananapi_cm4/Kconfig"
endif
```

## board/bananapi/bananapi_cm4/Kconfig
```kconfig
if TARGET_MESON_G12B

config SYS_CPU
	string
	default "armv8"

config SYS_BOARD
	string
	default "bananapi_cm4"

config SYS_VENDOR
	string
	default "bananapi"

config SYS_SOC
	string
	default "g12b"

config SYS_CONFIG_NAME
	default "bananapi_cm4"

endif
```

## board/bananapi/bananapi_cm5/Kconfig
```kconfig
if TARGET_BANANAPI_CM5

config ENV_HDMITX_ONLY
	string
	option env="BOARD_COMPILE_HDMITX_ONLY"

config HDMITX_ONLY
	bool "hdmi tx only"
	default y if ENV_HDMITX_ONLY="true"

config SYS_SOC
	default "t7"

config SYS_BOARD
	default "bananapi_cm5"

config SYS_VENDOR
	default "bananapi"

config SYS_CONFIG_NAME
	default "bananapi_cm5"

config DTB_BIND_KERNEL
    bool "load dtb from boot part but not flash rsv"
    default n

config CMD_PLLTEST
	bool "support plltest command"
	default n

config AML_REBOOT
       bool "reboot cmd"
       default y
endif
```

## board/bananapi/bananapi_firewalla/Kconfig
```kconfig
if TARGET_MESON_G12B

config SYS_CPU
	string
	default "armv8"

config SYS_BOARD
	string
	default "bananapi_firewalla"

config SYS_VENDOR
	string
	default "bananapi"

config SYS_SOC
	string
	default "g12b"

config SYS_CONFIG_NAME
	default "bananapi_firewalla"

endif
```
